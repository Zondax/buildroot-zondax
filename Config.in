## Config.in
```kconfig
source "$BR2_EXTERNAL_ZONDAXTEE_PATH/package/zondax/hellorustee/Config.in"
source "$BR2_EXTERNAL_ZONDAXTEE_PATH/package/zondax/tee-service/Config.in"
source "$BR2_EXTERNAL_ZONDAXTEE_PATH/package/zondax/py-cryptography/Config.in"
source "$BR2_EXTERNAL_ZONDAXTEE_PATH/package/zondax/py-cffi/Config.in"
source "$BR2_EXTERNAL_ZONDAXTEE_PATH/package/zondax/py-six/Config.in"
source "$BR2_EXTERNAL_ZONDAXTEE_PATH/package/zondax/py-pycparser/Config.in"
source "$BR2_EXTERNAL_ZONDAXTEE_PATH/package/zondax/rustc-nightly/Config.in"
source "$BR2_EXTERNAL_ZONDAXTEE_PATH/package/zondax/teestatus/Config.in"

source "$BR2_EXTERNAL_ZONDAXTEE_PATH/package/zondax/imx-cst/Config.in.host"
```

## board/zondax/stm32mp157/stm32.its
```
/dts-v1/;

/ {
	    description = "FIT image for secure uboot";
        #address-cells = <1>;

        images {
                kernel-1 {
                        description = "Linux kernel";
                        data = /incbin/("zImage");
                        type = "kernel";
                        arch = "arm";
                        os = "linux";
                        compression = "none";
                        load = <0xC0800000>;
                        entry = <0xC0800000>;
                        hash-1 {
                                algo = "sha256";
                        };
                        signature-1 {
                                algo = "sha256,rsa4096";
                                key-name-hint = "uboot_keys";
                        };
                };

                fdt-stm32mp157c-dk2-mx.dtb {
                        description = "Flattened Device Tree blob";
                        data = /incbin/("stm32mp157c-dk2-mx.dtb");
                        type = "flat_dt";
                        arch = "arm";
                        compression = "none";
                        hash-1 {
                                algo = "sha256";
                        };
                        signature-1 {
                                algo = "sha256,rsa4096";
                                key-name-hint = "uboot_keys";
                        };
                };
	};

    configurations {
         default = "conf-stm32mp157c-dk2.dtb";
         conf-stm32mp157c-dk2.dtb {
		     description = "1 Linux kernel, FDT blob";
		     kernel = "kernel-1";
		     fdt = "fdt-stm32mp157c-dk2-mx.dtb";
             hash-1 {
                     algo = "sha256";
             };
             signature-1 {
                     algo = "sha256,rsa4096";
                     key-name-hint = "uboot_keys";
		             sign-images = "kernel", "fdt";
             };
         };
	};
};
```

## configs/zondaxtee_imx8mmevk_defconfig
```kconfig
BR2_aarch64=y
BR2_ARM_FPU_VFPV3=y
BR2_CCACHE=y
BR2_ENABLE_DEBUG=y
BR2_GLOBAL_PATCH_DIR="$(BR2_EXTERNAL_ZONDAXTEE_PATH)/board/zondax/imx8mmevk/patches"
BR2_PER_PACKAGE_DIRECTORIES=y
BR2_TOOLCHAIN_EXTERNAL=y
BR2_PACKAGE_HOST_GDB=y
BR2_PACKAGE_HOST_LINUX_HEADERS_CUSTOM_5_10=y
BR2_TARGET_GENERIC_HOSTNAME="zondaxtee"
BR2_TARGET_GENERIC_ISSUE="Welcome to Zondax TEE"
BR2_TARGET_GENERIC_GETTY_PORT="ttymxc1"
BR2_ROOTFS_OVERLAY="$(BR2_EXTERNAL_ZONDAXTEE_PATH)/board/zondax/imx8mmevk/imx-overlay/  $(BR2_EXTERNAL_ZONDAXTEE_PATH)/board/zondax/common/rootfs-overlay/"
BR2_ROOTFS_POST_IMAGE_SCRIPT="$(BR2_EXTERNAL_ZONDAXTEE_PATH)/board/zondax/imx8mmevk/generate_keys.sh $(BR2_EXTERNAL_ZONDAXTEE_PATH)/board/zondax/imx8mmevk/imx8-bootloader-prepare.sh $(BR2_EXTERNAL_ZONDAXTEE_PATH)/board/zondax/imx8mmevk/sign_image.sh $(BR2_EXTERNAL_ZONDAXTEE_PATH)/board/zondax/imx8mmevk/post-image.sh"
BR2_ROOTFS_POST_SCRIPT_ARGS="${UBOOT_DIR}/arch/arm/dts/imx8mm-evk.dtb"
BR2_LINUX_KERNEL=y
BR2_LINUX_KERNEL_CUSTOM_GIT=y
BR2_LINUX_KERNEL_CUSTOM_REPO_URL="https://source.codeaurora.org/external/imx/linux-imx"
BR2_LINUX_KERNEL_CUSTOM_REPO_VERSION="lf-5.10.y-1.0.0"
BR2_LINUX_KERNEL_DEFCONFIG="imx_v8"
BR2_LINUX_KERNEL_DTS_SUPPORT=y
BR2_LINUX_KERNEL_INTREE_DTS_NAME="freescale/imx8mm-evk freescale/imx8mm-evk-revb-qca-wifi"
BR2_LINUX_KERNEL_NEEDS_HOST_OPENSSL=y
BR2_PACKAGE_BUSYBOX_CONFIG="../busybox.config"
BR2_PACKAGE_FREESCALE_IMX=y
BR2_PACKAGE_FREESCALE_IMX_PLATFORM_IMX8MM=y
BR2_PACKAGE_FIRMWARE_IMX=y
BR2_TARGET_ROOTFS_EXT2=y
BR2_TARGET_ROOTFS_EXT2_4=y
BR2_TARGET_ROOTFS_EXT2_SIZE="120M"
BR2_TARGET_ARM_TRUSTED_FIRMWARE=y
BR2_TARGET_ARM_TRUSTED_FIRMWARE_CUSTOM_GIT=y
BR2_TARGET_ARM_TRUSTED_FIRMWARE_CUSTOM_REPO_URL="https://source.codeaurora.org/external/imx/imx-atf"
BR2_TARGET_ARM_TRUSTED_FIRMWARE_CUSTOM_REPO_VERSION="5782363f92a2fdf926784449270433cf3ddf44bd"
BR2_TARGET_ARM_TRUSTED_FIRMWARE_PLATFORM="imx8mm"
BR2_TARGET_ARM_TRUSTED_FIRMWARE_BL31=y
BR2_TARGET_ARM_TRUSTED_FIRMWARE_ADDITIONAL_VARIABLES="NEED_BL32=yes BL32_BASE=0xbe000000 SPD=opteed"
BR2_PACKAGE_OPTEE_BENCHMARK=y
BR2_PACKAGE_OPTEE_EXAMPLES=y
BR2_PACKAGE_OPTEE_TEST=y
BR2_TARGET_OPTEE_OS=y
BR2_TARGET_OPTEE_OS_CUSTOM_GIT=y
BR2_TARGET_OPTEE_OS_CUSTOM_REPO_URL="https://source.codeaurora.org/external/imx/imx-optee-os"
BR2_TARGET_OPTEE_OS_CUSTOM_REPO_VERSION="c939619d64dea014ad1b8382356eee4d1cbfbb22"
BR2_TARGET_OPTEE_OS_PLATFORM="imx"
BR2_TARGET_OPTEE_OS_PLATFORM_FLAVOR="mx8mmevk"

# Custom key to sign TAs. Noted that this will cause erros running optee examples and tests
BR2_TARGET_OPTEE_OS_ADDITIONAL_VARIABLES="CFG_NXPCRYPT=y CFG_GEN_DEK_BLOB=y CFG_UNWIND=y CFG_NXP_CAAM=y TA_PUBLIC_KEY=$(BR2_EXTERNAL_ZONDAXTEE_PATH)/keys/optee_keys/optee_pub_key.pem"

BR2_TARGET_UBOOT=y
BR2_TARGET_UBOOT_BUILD_SYSTEM_KCONFIG=y
BR2_TARGET_UBOOT_CUSTOM_GIT=y
BR2_TARGET_UBOOT_CUSTOM_REPO_URL="https://source.codeaurora.org/external/imx/uboot-imx"
BR2_TARGET_UBOOT_CUSTOM_REPO_VERSION="lf-5.10.y-1.0.0"
BR2_TARGET_UBOOT_USE_CUSTOM_CONFIG=y
BR2_TARGET_UBOOT_CUSTOM_CONFIG_FILE="$(BR2_EXTERNAL_ZONDAXTEE_PATH)/board/zondax/imx8mmevk/uboot/imx8mm_evk_trusted_defconfig"
BR2_TARGET_UBOOT_NEEDS_DTC=y
BR2_TARGET_UBOOT_FORMAT_CUSTOM=y
BR2_TARGET_UBOOT_FORMAT_CUSTOM_NAME="u-boot-nodtb.bin"
BR2_TARGET_UBOOT_SPL=y
BR2_PACKAGE_HOST_DOSFSTOOLS=y
BR2_PACKAGE_HOST_GENIMAGE=y
BR2_PACKAGE_HOST_IMX_MKIMAGE=y
BR2_PACKAGE_HOST_MTOOLS=y
BR2_PACKAGE_HOST_UBOOT_TOOLS=y
BR2_PACKAGE_HOST_UBOOT_TOOLS_FIT_SUPPORT=y

# zondaxtee applications
BR2_PACKAGE_HELLORUSTEE=y
BR2_PACKAGE_HELLORUSTEE_SIGN_TA=y
BR2_PACKAGE_TEE_SERVICE=y
BR2_PACKAGE_TEE_SERVICE_SIGN_TA=y
BR2_PACKAGE_HOST_CARGO=y
BR2_PACKAGE_HOST_RUSTC_NIGHTLY=y

BR2_PACKAGE_HOST_IMX_CST=y
```

## configs/zondaxtee_stm32mp157_dk2_defconfig
```kconfig
BR2_arm=y
BR2_cortex_a7=y
BR2_CCACHE=y
BR2_ENABLE_DEBUG=y
BR2_PER_PACKAGE_DIRECTORIES=y
BR2_TOOLCHAIN_EXTERNAL=y
BR2_PACKAGE_HOST_GDB=y
BR2_ROOTFS_DEVICE_CREATION_DYNAMIC_EUDEV=y
BR2_TARGET_GENERIC_HOSTNAME="zondaxtee"
BR2_TARGET_GENERIC_ISSUE="Welcome to Zondax TEE"

BR2_ROOTFS_OVERLAY="$(BR2_EXTERNAL_ZONDAXTEE_PATH)/board/zondax/stm32mp157/dk2-overlay/ $(BR2_EXTERNAL_ZONDAXTEE_PATH)/board/zondax/common/rootfs-overlay/"
BR2_ROOTFS_POST_IMAGE_SCRIPT="$(BR2_EXTERNAL_ZONDAXTEE_PATH)/board/zondax/stm32mp157/post-image.sh"

BR2_LINUX_KERNEL=y
BR2_LINUX_KERNEL_CUSTOM_GIT=y
BR2_LINUX_KERNEL_CUSTOM_REPO_URL="https://github.com/STMicroelectronics/linux.git"
BR2_LINUX_KERNEL_CUSTOM_REPO_VERSION="v5.10-stm32mp-r2"
BR2_LINUX_KERNEL_USE_CUSTOM_CONFIG=y
BR2_LINUX_KERNEL_CUSTOM_CONFIG_FILE="$(BR2_EXTERNAL_ZONDAXTEE_PATH)/board/zondax/stm32mp157/linux.config"
BR2_LINUX_KERNEL_DTS_SUPPORT=y
BR2_LINUX_KERNEL_INTREE_DTS_NAME="stm32mp157c-dk2-mx"
BR2_LINUX_KERNEL_CUSTOM_DTS_PATH="$(BR2_EXTERNAL_ZONDAXTEE_PATH)/board/zondax/stm32mp157/linux-dts/*"
BR2_LINUX_KERNEL_INSTALL_TARGET=y

BR2_PACKAGE_BUSYBOX_CONFIG="$(BR2_EXTERNAL_ZONDAXTEE_PATH)/busybox.config"

BR2_PACKAGE_GCNANO_BINARIES=y
BR2_TARGET_ROOTFS_EXT2=y
BR2_TARGET_ROOTFS_EXT2_4=y
BR2_TARGET_ROOTFS_EXT2_SIZE="200M"

BR2_TARGET_ARM_TRUSTED_FIRMWARE=y
BR2_TARGET_ARM_TRUSTED_FIRMWARE_CUSTOM_GIT=y
BR2_TARGET_ARM_TRUSTED_FIRMWARE_CUSTOM_REPO_URL="https://github.com/STMicroelectronics/arm-trusted-firmware.git"
BR2_TARGET_ARM_TRUSTED_FIRMWARE_CUSTOM_REPO_VERSION="v2.4-stm32mp-r2"
BR2_TARGET_ARM_TRUSTED_FIRMWARE_PLATFORM="stm32mp1"
BR2_TARGET_ARM_TRUSTED_FIRMWARE_CUSTOM_DTS_PATH="$(BR2_EXTERNAL_ZONDAXTEE_PATH)/board/zondax/stm32mp157/tfa-dts/*"
BR2_TARGET_ARM_TRUSTED_FIRMWARE_FIP=y
BR2_TARGET_ARM_TRUSTED_FIRMWARE_BL32_OPTEE=y
BR2_TARGET_ARM_TRUSTED_FIRMWARE_UBOOT_AS_BL33=y
BR2_TARGET_ARM_TRUSTED_FIRMWARE_UBOOT_BL33_IMAGE="u-boot-nodtb.bin"
BR2_TARGET_ARM_TRUSTED_FIRMWARE_ADDITIONAL_VARIABLES="STM32MP_SDMMC=1 AARCH32_SP=optee DTB_FILE_NAME=stm32mp157c-dk2-mx.dtb STM32MP_USB_PROGRAMMER=1 BL33_CFG=$(BINARIES_DIR)/u-boot.dtb"

BR2_TARGET_ARM_TRUSTED_FIRMWARE_IMAGES="*.stm32 fip.bin"
BR2_TARGET_ARM_TRUSTED_FIRMWARE_NEEDS_DTC=y
BR2_PACKAGE_LIBDRM_INSTALL_TESTS=y
BR2_PACKAGE_OPTEE_EXAMPLES=y
BR2_PACKAGE_OPTEE_BENCHMARK=y
BR2_PACKAGE_OPTEE_TEST=y
BR2_TARGET_OPTEE_OS=y
BR2_TARGET_OPTEE_OS_CUSTOM_GIT=y
BR2_TARGET_OPTEE_OS_CUSTOM_REPO_URL="https://github.com/STMicroelectronics/optee_os.git"
BR2_TARGET_OPTEE_OS_CUSTOM_REPO_VERSION="3.12.0-stm32mp-r2"
BR2_TARGET_OPTEE_OS_PLATFORM="stm32mp1"
BR2_TARGET_OPTEE_OS_ADDITIONAL_VARIABLES="CFG_EMBED_DTB_SOURCE_FILE=stm32mp157c-dk2.dts CFG_TEE_CORE_LOG_LEVEL=4 CFG_TEE_CORE_DEBUG=y CFG_UNWIND=y"
BR2_TARGET_OPTEE_OS_PLATFORM_FLAVOR="157C_DK2"
BR2_TARGET_UBOOT=y
BR2_TARGET_UBOOT_BUILD_SYSTEM_KCONFIG=y
BR2_TARGET_UBOOT_CUSTOM_GIT=y
BR2_TARGET_UBOOT_CUSTOM_REPO_URL="https://github.com/STMicroelectronics/u-boot.git"
BR2_TARGET_UBOOT_CUSTOM_REPO_VERSION="v2020.10-stm32mp-r2"
BR2_TARGET_UBOOT_BOARD_DEFCONFIG="stm32mp15_trusted"
# BR2_TARGET_UBOOT_FORMAT_BIN is not set
BR2_TARGET_UBOOT_FORMAT_CUSTOM=y
BR2_TARGET_UBOOT_FORMAT_CUSTOM_NAME="u-boot-nodtb.bin u-boot.dtb"
BR2_TARGET_UBOOT_CUSTOM_DTS_PATH="../board/zondax/stm32mp157/uboot-dts/*"
BR2_TARGET_UBOOT_CUSTOM_MAKEOPTS="dtb-y=stm32mp157c-dk2-mx.dtb DEVICE_TREE=stm32mp157c-dk2-mx"
BR2_PACKAGE_HOST_GENIMAGE=y

# zondaxtee applications
BR2_PACKAGE_HELLORUSTEE=y
BR2_PACKAGE_TEE_SERVICE=y
BR2_PACKAGE_HOST_CARGO=y
BR2_PACKAGE_HOST_RUSTC_NIGHTLY=y
```

## package/zondax/byacc/Config.in.host
```kconfig
config BR2_PACKAGE_HOST_BYACC
	bool "host byacc"
	help
	  A parser generator utility that reads a grammar
	  specification from a file and generates an LR(1)
	  parser for it. The parsers consist of a set of
	  LALR(1) parsing tables and a driver routine written
	  in the C programming language.

	  http://invisible-island.net/byacc/
```

## package/zondax/hellorustee/Config.in
```kconfig
# This is required so the package can be enabled/disabled
config BR2_PACKAGE_HELLORUSTEE
	bool "hellorustee"
	depends on BR2_PACKAGE_HOST_RUSTC_NIGHTLY_TARGET_ARCH_SUPPORTS
	depends on BR2_TARGET_OPTEE_OS
	depends on BR2_TOOLCHAIN_HAS_THREADS
	depends on !BR2_STATIC_LIBS
	depends on BR2_TOOLCHAIN_HEADERS_AT_LEAST_4_3
	select BR2_PACKAGE_OPTEE_CLIENT
	select BR2_TARGET_OPTEE_OS_SDK 
    select BR2_PACKAGE_HOST_RUSTC_BIN_NIGHTLY
    select BR2_PACKAGE_HOST_RUSTC_NIGHTLY

#.. now add other configuration options 
# reference https://bootlin.com/doc/training/buildroot/buildroot-slides.pdf
```

## package/zondax/imx-cst/Config.in.host
```kconfig
config BR2_PACKAGE_HOST_IMX_CST
	bool "host imx-cst"
	help
	  I.MX code signing tool provides software code signing
	  support designed that integrate the HABv4 and AHAB
	  library.

	  https://www.nxp.com/webapp/sps/download/license.jsp?colCode=IMX_CST_TOOL
```

## package/zondax/py-cffi/Config.in
```kconfig
config BR2_PACKAGE_PY_CFFI
	bool "py-cffi"
	select BR2_PACKAGE_LIBFFI
	select BR2_PACKAGE_PY_PYCPARSER # runtime
	help
	  This is the Foreign Function Interface for Python calling C
	  code. The aim of this project is to provide a convenient
	  and reliable way of calling C code from Python.

	  https://pypi.python.org/pypi/cffi
```

## package/zondax/py-pycparser/Config.in
```kconfig
config BR2_PACKAGE_PY_PYCPARSER
	bool "py-pycparser"
	help
	  C parser in Python

	  https://github.com/eliben/pycparser
```

## package/zondax/teestatus/Config.in
```kconfig
# This is required so the package can be enabled/disabled
config BR2_PACKAGE_TEESTATUS
	bool "teestatus"
```
